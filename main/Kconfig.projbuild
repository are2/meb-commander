## main/Kconfig.projbuild
```kconfig
menu "MEB Preheat"

    config MEB_PRODUCTION_BUILD
        bool "Production mode build"
        default n
        help
            Enables production-oriented firmware settings. Development builds
            should leave this disabled so USB-JTAG flashing/debugging remains
            reliable.

    config MEB_AUTOMATIC_LIGHT_SLEEP
        bool "Enable automatic light sleep"
        depends on PM_ENABLE && FREERTOS_USE_TICKLESS_IDLE
        default y if MEB_PRODUCTION_BUILD
        default n
        help
            Allows ESP-IDF power management to enter automatic light sleep
            while the system is idle. This saves power, but can make USB-JTAG
            flashing/debugging unreliable on ESP32-C5.

    config MEB_JTAG_BOOT_GRACE_MS
        int "Development JTAG no-light-sleep boot grace period"
        default 0 if MEB_PRODUCTION_BUILD
        default 30000
        range 0 300000
        help
            Time after boot to hold an ESP_PM_NO_LIGHT_SLEEP lock when
            automatic light sleep is enabled. Production builds default to
            zero so low-power behavior starts immediately.

    config MEB_DISABLE_SAFETY_AUTO_OFF
        bool "Disable heating safety auto-off"
        default n
        help
            Disables the hard heating auto-off limit. Leave this disabled for
            the default safety behavior, which turns heating off after the
            configured safety duration even when no user timer is set.

    config MEB_SAFETY_AUTO_OFF_MINUTES
        int "Heating safety auto-off limit in minutes"
        depends on !MEB_DISABLE_SAFETY_AUTO_OFF
        default 180
        range 1 1440
        help
            Maximum time heating may stay enabled after a user enables it.
            The default is 180 minutes, or 3 hours.

endmenu
```

## sdkconfig.defaults.production
```kconfig
CONFIG_MEB_PRODUCTION_BUILD=y
CONFIG_MEB_AUTOMATIC_LIGHT_SLEEP=y
CONFIG_MEB_JTAG_BOOT_GRACE_MS=0

CONFIG_BT_LE_SLEEP_ENABLE=y
CONFIG_BT_LE_LP_CLK_SRC_MAIN_XTAL=y
CONFIG_PM_ENABLE=y
CONFIG_PM_POWER_DOWN_CPU_IN_LIGHT_SLEEP=y
CONFIG_PM_SLP_DISABLE_GPIO=y
CONFIG_FREERTOS_USE_TICKLESS_IDLE=y
CONFIG_FREERTOS_IDLE_TIME_BEFORE_SLEEP=3
CONFIG_ESP_MODEM_CLOCK_ENABLE_CHECKING=y

CONFIG_ESP_SYSTEM_PANIC_PRINT_REBOOT=y
CONFIG_ESP_SYSTEM_PANIC_REBOOT_DELAY_SECONDS=0
CONFIG_ESP_SYSTEM_NO_BACKTRACE=y
# CONFIG_ESP_SYSTEM_USE_EH_FRAME is not set
# CONFIG_ESP_SYSTEM_USE_FRAME_POINTER is not set
# CONFIG_ESP_COREDUMP_ENABLE_TO_FLASH is not set
# CONFIG_ESP_COREDUMP_ENABLE_TO_UART is not set
CONFIG_ESP_COREDUMP_ENABLE_TO_NONE=y
```
